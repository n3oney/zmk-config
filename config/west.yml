## config/west.yml
```yaml
manifest:
  remotes:
    - name: zmkfirmware
      url-base: https://github.com/zmkfirmware
    - name: dmhuisma
      url-base: https://github.com/dmhuisma
    - name: petejohanson
      url-base: https://github.com/petejohanson
    - name: halfdane
      url-base: https://github.com/halfdane
    - name: oleksandr
      url-base: https://github.com/oleksandrmaslov
  projects:
    - name: zephyr
      remote: zmkfirmware
      revision: v3.5.0+zmk-fixes
      clone-depth: 1
      import:
        name-blocklist:
          - ci-tools
          - hal_altera
          - hal_cypress
          - hal_infineon
          - hal_microchip
          - hal_nxp
          - hal_openisa
          - hal_silabs
          - hal_xtensa
          - hal_st
          - hal_ti
          - loramac-node
          - mcuboot
          - mcumgr
          - net-tools
          - openthread
          - edtt
          - trusted-firmware-m
    - name: zmk
      remote: zmkfirmware
      revision: v0.3.0  # main
      import: app/west.yml
      clone-depth: 1
    - name: zmk_arbitrary_split_data_channel
      remote: dmhuisma
      revision: main
      clone-depth: 1
    - name: zmk-split-status-relay
      remote: dmhuisma
      revision: main
      clone-depth: 1
    - name: nice-view-battery-peripheral
      remote: dmhuisma
      revision: main
      clone-depth: 1
    - name: zmk-input-gestures
      remote: halfdane
      revision: main
      clone-depth: 1
    - name: zmk-input-processors
      remote: halfdane
      revision: main
      clone-depth: 1
    - name: cirque-input-module
      remote: halfdane
      revision: absolute_mode
      clone-depth: 1
  self:
    path: config
```
